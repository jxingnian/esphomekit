## main/Kconfig.projbuild
```kconfig
menu "Example Configuration"

    config ESP_WIFI_SSID
        string "WiFi SSID"
        default "myssid"
        help
            SSID (network name) for the example to connect to.

    config ESP_WIFI_PASSWORD
        string "WiFi Password"
        default "mypassword"
        help
            WiFi password (WPA or WPA2) for the example to use.
    config ESP_WIFI_CHANNEL
        int "WiFi Channel"
        range 1 13
        default 1
        help
            WiFi channel (network channel) for the example to use.

    config ESP_MAX_STA_CONN
        int "Maximal STA connections"
        default 4
        help
            Max number of the STA connects to AP.
   
    config BROKER_URL
        string "Broker URL"
        default "mqtt://mqtt.eclipseprojects.io"
        help
            URL of the broker to connect to

    config BROKER_URL_FROM_STDIN
        bool
        default y if BROKER_URL = "FROM_STDIN"

    config EXAMPLE_USE_HARDCODED_SETUP_CODE
        bool "Use hard-coded setup code"
        default y
        help
            HomeKit does not recommend having the setup code programmed in the accessory as is.
            Instead, it expects setup info (salt-verifier pair) generated for the given setup code.
            Use this option only for testing purposes. For production, the setup info should be
            used.

    config EXAMPLE_SETUP_CODE
        string "HomeKit Setup Code"
        default "111-22-333"
        depends on EXAMPLE_USE_HARDCODED_SETUP_CODE
        help
            Setup code to be used for HomeKot pairing, if hard-coded setup code is enabled.

    config EXAMPLE_SETUP_ID
        string "HomeKit Setup Id"
        default "ES32"
        depends on EXAMPLE_USE_HARDCODED_SETUP_CODE
        help
            Setup id to be used for HomeKot pairing, if hard-coded setup code is enabled.

endmenu
```
